/* < DTS2015112101477 lwx247446 20151121 begin */
&tlmm_pinmux {
	usb-id-pin {
		qcom,pins = <&gp 118>;
		qcom,num-grp-pins = <1>;
		qcom,pin-func = <0>;
		label = "usb-id-pin";
		usbid_default: default {
			drive-strength = <8>;
			bias-pull-up;
		};
	};
};




&usb_otg {
/* < DTS2015072907420 ywx204768 20150730 begin */
        qcom,hsusb-otg-phy-init-seq =
         	<0x74 0x80 0x65 0x81 0x31 0x82 0x33 0x83 0xffffffff>;
	qcom,hsusb-otg-phy-init-seq-host =
		<0x74 0x80 0x64 0x81 0x31 0x82 0x33 0x83 0xffffffff>;
/* DTS2015072907420 ywx204768 20150730 end >*/
	qcom,hsusb-otg-mode = <3>;
	vbus_otg-supply = <&bq24296_otg_supply>;
        qcom,usbid-gpio = <&msm_gpio 118 0>; 
	pinctrl-names = "default"; 
	pinctrl-0 = <&usbid_default>;
};
/* DTS2015112101477 lwx247446 20151121 end >*/
