/* Copyright (c) 2013, The Linux Foundation. All rights reserved.
 *
 * This program is free software; you can redistribute it and/or modify
 * it under the terms of the GNU General Public License version 2 and
 * only version 2 as published by the Free Software Foundation.
 *
 * This program is distributed in the hope that it will be useful,
 * but WITHOUT ANY WARRANTY; without even the implied warranty of
 * MERCHANTABILITY or FITNESS FOR A PARTICULAR PURPOSE.  See the
 * GNU General Public License for more details.
 */

/*---------------------------------------------------------------------------
 * This file is autogenerated file using gcdb parser. Please do not edit it.
 * Update input XML file to add a new entry or update variable in this file
 * VERSION = "1.0"
 *---------------------------------------------------------------------------*/
&mdss_mdp {
	dsi_jdi_r69429_7_1200p_cmd: qcom,mdss_dsi_jdi_r69429_7_1200p_cmd {
		qcom,mdss-dsi-panel-name = "JDI_R69429_7_1200P_CMD";
		qcom,cont-splash-enabled;
		qcom,mdss-dsi-panel-controller = <&mdss_dsi0>;
		qcom,mdss-dsi-panel-type = "dsi_cmd_mode";
		qcom,mdss-dsi-panel-destination = "display_1";
		qcom,mdss-dsi-panel-clockrate = <979000000>;
		qcom,mdss-dsi-panel-framerate = <60>;
		qcom,mdss-dsi-virtual-channel-id = <0>;
		qcom,mdss-dsi-stream = <0>;
		qcom,mdss-dsi-panel-width = <1200>;
		qcom,mdss-dsi-panel-height = <1920>;
		qcom,mdss-dsi-h-front-porch = <80>;
		qcom,mdss-dsi-h-back-porch = <64>;
		qcom,mdss-dsi-h-pulse-width = <16>;
		qcom,mdss-dsi-h-sync-skew = <0>;
		qcom,mdss-dsi-v-back-porch = <32>;
		qcom,mdss-dsi-v-front-porch = <32>;
		qcom,mdss-dsi-v-pulse-width = <16>;
		qcom,mdss-dsi-h-left-border = <0>;
		qcom,mdss-dsi-h-right-border = <0>;
		qcom,mdss-dsi-v-top-border = <0>;
		qcom,mdss-dsi-v-bottom-border = <0>;
		qcom,mdss-dsi-bpp = <24>;
		qcom,mdss-dsi-underflow-color = <0xff>;
		qcom,mdss-dsi-border-color = <0>;
		qcom,mdss-dsi-color-order = "rgb_swap_rgb";
		qcom,mdss-dsi-on-command = [29 01 00 00 00 00 02 B0 00
	29 01 00 00 00 00 06 B3 04 08 00 22 00
	29 01 00 00 00 00 03 B6 3A D3
	29 01 00 00 00 00 07 B8 07 90 1E 00 1E 32
	29 01 00 00 00 00 07 B9 07 82 3c 00 3C 87
	29 01 00 00 00 00 07 BA 07 9E 20 00 20 8F
	29 01 00 00 00 00 18 CE 7D 40 43 49 55 62 71 82 94 A8 B9 CB DB E9 F5 FC FF 01 38 02 02 44 24
	29 01 00 00 00 00 02 D6 01
	29 01 00 00 00 00 15 C6 78 01 45 05 67 67 0A 01 01 01 01 01 01 01 01 01 01 0A 19 05
	15 01 00 00 00 00 02 3A 77
	39 01 00 00 00 00 03 44 07 7F
	39 01 00 00 00 00 05 2A 00 00 04 AF
	39 01 00 00 00 00 05 2B 00 00 07 7F
	39 01 00 00 00 00 02 2C 00
	15 01 00 00 00 00 02 51 00
	15 01 00 00 00 00 02 53 24
	15 01 00 00 00 00 02 5E 06
	15 01 00 00 00 00 02 55 01
	05 01 00 00 6E 00 02 11 00
	05 01 00 00 14 00 02 29 00];
		qcom,mdss-dsi-off-command = [05 01 00 00 14 00 02 28 00
	05 01 00 00 50 00 02 10 00];
		qcom,mdss-dsi-on-command-state = "dsi_lp_mode";
		qcom,mdss-dsi-off-command-state = "dsi_hs_mode";
		qcom,mdss-dsi-h-sync-pulse = <1>;
		qcom,mdss-dsi-traffic-mode = "burst_mode";
		qcom,mdss-dsi-lane-map = "lane_map_0123";
		qcom,mdss-dsi-bllp-eof-power-mode;
		qcom,mdss-dsi-bllp-power-mode;
		qcom,mdss-dsi-lane-0-state;
		qcom,mdss-dsi-lane-1-state;
		qcom,mdss-dsi-lane-2-state;
		qcom,mdss-dsi-lane-3-state;
		qcom,mdss-dsi-te-pin-select = <1>;
		qcom,mdss-dsi-te-v-sync-rd-ptr-irq-line = <0x2c>;
		qcom,mdss-dsi-te-dcs-command = <1>;
		qcom,mdss-dsi-te-check-enable;
		qcom,mdss-dsi-te-using-te-pin;
		qcom,mdss-dsi-panel-timings = [FE 3C 2A 00 70 74 2E 40 30 03 04 00];
		qcom,mdss-dsi-t-clk-post = <0x02>;
		qcom,mdss-dsi-t-clk-pre = <0x2D>;
		qcom,mdss-dsi-bl-min-level = <6>;
		qcom,mdss-dsi-bl-max-level = <255>;
		qcom,mdss-dsi-dma-trigger = "trigger_sw";
		qcom,mdss-dsi-mdp-trigger = "none";
		qcom,mdss-dsi-bl-pmic-control-type = "bl_ctrl_dcs";
		qcom,panel-cabc-off-cmds = [15 01 00 00 00 00 02 55 00];
		qcom,panel-cabc-moving-cmds = [15 01 00 00 00 00 02 55 03];
		qcom,panel-cabc-still-cmds = [15 01 00 00 00 00 02 55 02];
		qcom,panel-cabc-ui-commands = [15 01 00 00 00 00 02 55 01];
		qcom,cabc-off-cmds-dsi-state = "dsi_hs_mode";
		qcom,cabc-moving-cmds-dsi-state = "dsi_hs_mode";
		qcom,cabc-still-cmds-dsi-state = "dsi_hs_mode";
		qcom,cabc-ui-commands-dsi-state = "dsi_hs_mode";
		huawei,cabc-default-mode = <1>;
		qcom,inverse-on-cmds-dsi-state = "dsi_hs_mode";
		qcom,inverse-off-cmds-dsi-state = "dsi_hs_mode";
		qcom,panel-cabc-ui-cmds = [15 01 00 00 00 00 02 55 01];
		qcom,panel-cabc-video-cmds = [15 01 00 00 00 00 02 55 03];
		qcom,cabc-ui-cmds-dsi-state = "dsi_hs_mode";
		qcom,cabc-video-cmds-dsi-state = "dsi_hs_mode";
		qcom,panel-esd-check-enabled;
		qcom,panel-esd-read-commands = [06 01 00 00 00 00 02 0A 1C];
		qcom,esd-read-cmds-state = "dsi_hs_mode";
		qcom,mdss-dsi-lp11-init;
		qcom,mdss-dsi-mipi-rst-delay = <80>;
		huawei,product-pad-flag = <1>;
		huawei,which-product-pad = <1>;
		qcom,partial-update-enabled;
		qcom,panel-roi-alignment = <8 8 8 8 1200 40>;
		huawei,low-brightness-no-dimming = <30>;
		huawei,attenuate_blue_coff = <0>;
		qcom,mdss-dsi-tx-eot-append;
		huawei,long-read-flag = <1>;
		huawei,reg-read-expect-value = <0x1C>;
			qcom,mdss-dsi-reset-sequence = <1 10>, <0 10>, <1 5>;

	};
};
