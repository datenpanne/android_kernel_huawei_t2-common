 / {
        huawei_fac_info {
                  compatible = "huawei,hw_fac_info";
                  fac,product_name = "HUAWEI PLE-701L";
                  fac,hardware_ver = "SH1PLE701LM";
                  fac,software_ver = "MSM8939_PLE_701L_VA";
                  status = "ok";
        };
};